## Documentation/devicetree/bindings/display/bridge/analogix,anx7688-bridge.yaml
```yaml
# SPDX-License-Identifier: (GPL-2.0-only OR BSD-2-Clause)
%YAML 1.2
---
$id: http://devicetree.org/schemas/display/bridge/analogix,anx7688-bridge.yaml#
$schema: http://devicetree.org/meta-schemas/core.yaml#

title: Analogix ANX7688 HDMI to DisplayPort Bridge

maintainers:
  - Nicolas Boichat <drinkcat@chromium.org>
  - Enric Balletbo i Serra <enric.balletbo@collabora.com>

description: |
  The ANX7688 bridge describes the HDMI 2.0 to DisplayPort 1.3 bridge block
  included in the ANX7688 chip controller. These are meant to be used for
  controlling display-related signals.

  The node of this device should be under an analogix,anx7866 node. Please refer
  to Documentation/devicetree/bindings/mfd/analogix,anx7688.yaml for the ANX7688
  core bindings.

properties:
  compatible:
    const: analogix,anx7688-bridge

  ports:
    type: object

    properties:
      port@0:
        type: object
        description: |
          Video port for HDMI input

      port@1:
        type: object
        description: |
          Video port for DP output

    required:
      - port@0

required:
  - compatible
  - ports

examples:
  - |
    i2c0 {
        #address-cells = <1>;
        #size-cells = <0>;

        anx7688: anx7688@2c {
            compatible = "analogix,anx7688";
            reg = <0x2c>;

            bridge {
                compatible = "analogix,anx7688-bridge";

                ports {
                    #address-cells = <1>;
                    #size-cells = <0>;

                    port@0 {
                        reg = <0>;
                        anx7688_in: endpoint {
                            remote-endpoint = <&hdmi0_out>;
                        };
                    };

                    port@1 {
                        reg = <1>;
                        anx7688_out: endpoint {
                            remote-endpoint = <&typec0_connector>;
                       };
                    };
                };
            };
        };
    };
```

## Documentation/devicetree/bindings/mfd/analogix,anx7688.yaml
```yaml
# SPDX-License-Identifier: (GPL-2.0-only OR BSD-2-Clause)
%YAML 1.2
---
$id: http://devicetree.org/schemas/mfd/analogix,anx7688.yaml#
$schema: http://devicetree.org/meta-schemas/core.yaml#

title: Analogix ANX7688 HDMI to USB Type-C Bridge (Port Controller with MUX)

maintainers:
  - Nicolas Boichat <drinkcat@chromium.org>
  - Enric Balletbo i Serra <enric.balletbo@collabora.com>

description: |
  ANX7688 converts HDMI 2.0 to DisplayPort 1.3 Ultra-HDi (4096x2160p60)
  including an intelligent crosspoint switch to support USB Type-C (USB-C).
  The integrated crosspoint switch supports USB 3.1 data transfer along with
  the DisplayPort Alternate Mode signaling over USB Type-C. Additionally,
  an on-chip microcontroller (OCM) is available to manage the signal switching,
  Channel Configuration (CC) detection, USB Power Delivery (USB-PD), Vendor
  Defined Message (VDM) protocol support and other functions as defined in the
  USB TypeC and USB Power Delivery specifications.

  As a result, a multi-function device is exposed as parent of the video
  bridge, TCPC and MUX blocks.

properties:
  compatible:
    const: analogix,anx7688

  reg:
    maxItems: 1
    description: I2C address of the device

required:
  - compatible
  - reg

examples:
  - |
    i2c0 {
        #address-cells = <1>;
        #size-cells = <0>;

        anx7688: anx7688@2c {
            compatible = "analogix,anx7688";
            reg = <0x2c>;
        };
    };
```

## Documentation/devicetree/bindings/power/mediatek,power-controller.yaml
```yaml
# SPDX-License-Identifier: (GPL-2.0-only OR BSD-2-Clause)
%YAML 1.2
---
$id: http://devicetree.org/schemas/power/mediatek,power-controller.yaml#
$schema: http://devicetree.org/meta-schemas/core.yaml#

title: Mediatek Power Domains Controller

maintainers:
  - Weiyi Lu <weiyi.lu@mediatek.com>
  - Matthias Brugger <mbrugger@suse.com>

description: |
  Mediatek processors include support for multiple power domains which can be
  powered up/down by software based on different application scenes to save power.

  IP cores belonging to a power domain should contain a 'power-domains'
  property that is a phandle for SCPSYS node representing the domain.

properties:
  $nodename:
    pattern: "^syscon@[0-9a-f]+$"

  compatible:
    items:
      - enum:
        - mediatek,mt8173-power-controller
      - const: syscon

  reg:
    maxItems: 1

patternProperties:
  "^.*@[0-9]$":
    type: object
    description: |
      Represents the power domains within the power controller node as documented
      in Documentation/devicetree/bindings/power/power-domain.yaml.

    properties:
      reg:
        description: |
          Power domain index. Valid values are defined in:
              "include/dt-bindings/power/mt8173-power.h" - for MT8173 type power domain.
        maxItems: 1

      '#power-domain-cells':
        description:
          Documented by the generic PM Domain bindings in
          Documentation/devicetree/bindings/power/power-domain.yaml.

      clocks:
        description: |
          A number of phandles to clocks that need to be enabled during domain
          power-up sequencing.

      clock-names:
        description: |
          List of names of clocks, in order to match the power-up sequencing
          for each power domain we need to group the clocks by name. BASIC
          clocks need to be enabled before enabling the corresponding power
          domain, and should not have a '-' in their name (i.e mm, mfg, venc).
          SUSBYS clocks need to be enabled before releasing the bus protection,
          and should contain a '-' in their name (i.e mm-0, isp-0, cam-0).

          In order to follow properly the power-up sequencing, the clocks must
          be specified by order, adding first the BASIC clocks followed by the
          SUSBSYS clocks.

      mediatek,infracfg:
        $ref: /schemas/types.yaml#definitions/phandle
        description: phandle to the device containing the INFRACFG register range.

      mediatek,smi:
        $ref: /schemas/types.yaml#definitions/phandle
        description: phandle to the device containing the SMI register range.

    required:
      - reg
      - '#power-domain-cells'

    additionalProperties: false

required:
  - compatible
  - reg

additionalProperties: false

examples:
  - |
    #include <dt-bindings/clock/mt8173-clk.h>
    #include <dt-bindings/power/mt8173-power.h>

    soc {
        #address-cells = <2>;
        #size-cells = <2>;

        scpsys: syscon@10006000 {
            compatible = "mediatek,mt8173-power-controller", "syscon";
            reg = <0 0x10006000 0 0x1000>;

            #address-cells = <1>;
            #size-cells = <0>;

            /* power domains of the SoC */
            vdec@MT8173_POWER_DOMAIN_VDEC {
                reg = <MT8173_POWER_DOMAIN_VDEC>;
                clocks = <&topckgen CLK_TOP_MM_SEL>;
                clock-names = "mm";
                #power-domain-cells = <0>;
            };

            venc@MT8173_POWER_DOMAIN_VENC {
                reg = <MT8173_POWER_DOMAIN_VENC>;
                clocks = <&topckgen CLK_TOP_MM_SEL>,
                         <&topckgen CLK_TOP_VENC_SEL>;
                clock-names = "mm", "venc";
                #power-domain-cells = <0>;
            };
            isp@MT8173_POWER_DOMAIN_ISP {
                reg = <MT8173_POWER_DOMAIN_ISP>;
                clocks = <&topckgen CLK_TOP_MM_SEL>;
                clock-names = "mm";
                #power-domain-cells = <0>;
            };
            mm@MT8173_POWER_DOMAIN_MM {
                reg = <MT8173_POWER_DOMAIN_MM>;
                clocks = <&topckgen CLK_TOP_MM_SEL>;
                clock-names = "mm";
                #power-domain-cells = <0>;
                mediatek,infracfg = <&infracfg>;
            };
            venc_lt@MT8173_POWER_DOMAIN_VENC_LT {
                reg = <MT8173_POWER_DOMAIN_VENC_LT>;
                clocks = <&topckgen CLK_TOP_MM_SEL>,
                         <&topckgen CLK_TOP_VENC_LT_SEL>;
                clock-names = "mm", "venclt";
                #power-domain-cells = <0>;
            };
            audio@MT8173_POWER_DOMAIN_AUDIO {
                reg = <MT8173_POWER_DOMAIN_AUDIO>;
                #power-domain-cells = <0>;
            };
            usb@MT8173_POWER_DOMAIN_USB {
                reg = <MT8173_POWER_DOMAIN_USB>;
                #power-domain-cells = <0>;
            };
            mfg_async@MT8173_POWER_DOMAIN_MFG_ASYNC {
                reg = <MT8173_POWER_DOMAIN_MFG_ASYNC>;
                clocks = <&clk26m>;
                clock-names = "mfg";
                #address-cells = <1>;
                #size-cells = <0>;
                #power-domain-cells = <1>;

                mfg_2d@MT8173_POWER_DOMAIN_MFG_2D {
                    reg = <MT8173_POWER_DOMAIN_MFG_2D>;
                    #address-cells = <1>;
                    #size-cells = <0>;
                    #power-domain-cells = <1>;

                    mfg@MT8173_POWER_DOMAIN_MFG {
                        reg = <MT8173_POWER_DOMAIN_MFG>;
                        #power-domain-cells = <0>;
                        mediatek,infracfg = <&infracfg>;
                    };
                };
            };
        };
    };
```

## drivers/gpu/drm/bridge/analogix/Kconfig
```kconfig
# SPDX-License-Identifier: GPL-2.0-only
config DRM_ANALOGIX_ANX6345
	tristate "Analogix ANX6345 bridge"
	depends on OF
	select DRM_ANALOGIX_DP
	select DRM_KMS_HELPER
	select REGMAP_I2C
	help
	  ANX6345 is an ultra-low Full-HD DisplayPort/eDP
	  transmitter designed for portable devices. The
	  ANX6345 transforms the LVTTL RGB output of an
	  application processor to eDP or DisplayPort.

config DRM_ANALOGIX_ANX7688
	tristate "Analogix ANX7688 bridge"
	select DRM_KMS_HELPER
	select MFD_ANX7688
	help
	  ANX7688 is an ultra-low power 4k Ultra-HD (4096x2160p60)
	  mobile HD transmitter designed for portable devices. The
	  ANX7688 converts HDMI 2.0 to DisplayPort 1.3 Ultra-HD.

config DRM_ANALOGIX_ANX78XX
	tristate "Analogix ANX78XX bridge"
	select DRM_ANALOGIX_DP
	select DRM_KMS_HELPER
	select REGMAP_I2C
	help
	  ANX78XX is an ultra-low power Full-HD SlimPort transmitter
	  designed for portable devices. The ANX78XX transforms
	  the HDMI output of an application processor to MyDP
	  or DisplayPort.

config DRM_ANALOGIX_DP
	tristate
	depends on DRM
```
